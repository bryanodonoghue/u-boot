## arch/arm/mach-rmobile/Kconfig.64
```kconfig
if RCAR_GEN3

choice
	prompt "Select Target SoC"

config R8A7795
	bool "Renesas SoC R8A7795"

config R8A7796
	bool "Renesas SoC R8A7796"

config R8A77970
	bool "Renesas SoC R8A77970"

config R8A77980
	bool "Renesas SoC R8A77980"

config R8A77990
	bool "Renesas SoC R8A77990"

config R8A77995
	bool "Renesas SoC R8A77995"

endchoice

choice
	prompt "Renesus ARM64 SoCs board select"
	optional

config TARGET_DRAAK
	bool "Draak board"
	help
          Support for Renesas R-Car Gen3 Draak platform

config TARGET_EAGLE
	bool "Eagle board"
	help
          Support for Renesas R-Car Gen3 Eagle platform

config TARGET_V3MSK
	bool "V3MSK board"
	help
          Support for Renesas R-Car Gen3 V3MSK platform

config TARGET_CONDOR
	bool "Condor board"
	help
          Support for Renesas R-Car Gen3 Condor platform

config TARGET_V3HSK
	bool "V3HSK board"
	help
          Support for Renesas R-Car Gen3 V3HSK platform

config TARGET_EBISU
	bool "Ebisu board"
	help
          Support for Renesas R-Car Gen3 Ebisu platform

config TARGET_SALVATOR_X
	bool "Salvator-X board"
	help
          Support for Renesas R-Car Gen3 platform

config TARGET_ULCB
	bool "ULCB board"
	help
          Support for Renesas R-Car Gen3 ULCB platform

endchoice

config SYS_SOC
	default "rmobile"

source "board/renesas/draak/Kconfig"
source "board/renesas/eagle/Kconfig"
source "board/renesas/v3msk/Kconfig"
source "board/renesas/condor/Kconfig"
source "board/renesas/v3hsk/Kconfig"
source "board/renesas/ebisu/Kconfig"
source "board/renesas/salvator-x/Kconfig"
source "board/renesas/ulcb/Kconfig"

endif
```

## board/avl/adas/Kconfig
```kconfig
if TARGET_ADAS

config SYS_SOC
	default "rmobile"

config SYS_BOARD
	default "adas"

config SYS_VENDOR
	default "avl"

config SYS_CONFIG_NAME
	default "adas"

endif
```
